## components/board/Kconfig.projbuild
```kconfig
menu "Board configuration"
    depends on IDF_TARGET_ESP32S3

    # -------------------------------------------------------------------------
    # Power / GPIO control
    # -------------------------------------------------------------------------
    config BOARD_PIN_PWR_ON
        int "PWR_ON pin"
        range 0 48
        default 48

    config BOARD_PIN_LED_EN
        int "LED_EN pin"
        range 0 48
        default 36

    config BOARD_PIN_LED_RESET_N
        int "LED_nRESET pin"
        range 0 48
        default 37

    config BOARD_PIN_LED_FAULT1_N
        int "LED_nFAULT_1 pin"
        range 0 48
        default 39

    config BOARD_PIN_LED_FAULT2_N
        int "LED_nFAULT_2 pin"
        range 0 48
        default 40

    config BOARD_PIN_HP_DET
        int "HP_DET pin"
        range 0 48
        default 47

    config BOARD_PIN_AC_NOK
        int "AC_nOK pin"
        range 0 48
        default 41

    config BOARD_PIN_CHG_OK
        int "CHG_OK pin"
        range 0 48
        default 42

    config BOARD_PIN_KEY_INT_N
        int "KEY_nINT pin"
        range 0 48
        default 6

    config BOARD_PIN_FUSB_INT_N
        int "FUSB_nINT pin"
        range 0 48
        default 3

    config BOARD_PIN_MEMS_INT1
        int "MEMS_INT1 pin"
        range 0 48
        default 11

    # -------------------------------------------------------------------------
    # ADC
    # -------------------------------------------------------------------------
    config BOARD_VBAT_ADC_PIN
        int "VBAT ADC pin"
        range 0 48
        default 1

    config BOARD_REV_ADC_PIN
        int "REV ADC pin"
        range 0 48
        default 9

    # -------------------------------------------------------------------------
    # I2C
    # -------------------------------------------------------------------------
    config BOARD_I2C0_SDA_PIN
        int "I2C0 SDA pin"
        range 0 48
        default 17

    config BOARD_I2C0_SCL_PIN
        int "I2C0 SCL pin"
        range 0 48
        default 18

    config BOARD_I2C1_SDA_PIN
        int "I2C1 SDA pin"
        range 0 48
        default 26

    config BOARD_I2C1_SCL_PIN
        int "I2C1 SCL pin"
        range 0 48
        default 21

    # -------------------------------------------------------------------------
    # UART0 debug
    # -------------------------------------------------------------------------
    config BOARD_UART0_TX_PIN
        int "UART0 TX pin"
        range 0 48
        default 43

    config BOARD_UART0_RX_PIN
        int "UART0 RX pin"
        range 0 48
        default 44

    # -------------------------------------------------------------------------
    # Encoder
    # -------------------------------------------------------------------------
    config BOARD_ENCODER_A_PIN
        int "Encoder A pin"
        range 0 48
        default 33

    config BOARD_ENCODER_B_PIN
        int "Encoder B pin"
        range 0 48
        default 34

    config BOARD_ENCODER_SW_N_PIN
        int "Encoder switch pin"
        range 0 48
        default 35

endmenu
```

## main/Kconfig.projbuild
```kconfig
menu "Main Fabli configuration"

    choice
        prompt "Console output"
        default FABLI_CONSOLE_UART

        config FABLI_CONSOLE_UART
            bool "Serial Debug"

        config FABLI_CONSOLE_USB
            bool "USB"

    endchoice

endmenu
```
